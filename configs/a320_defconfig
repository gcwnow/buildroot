## configs/a320_defconfig
```kconfig
BR2_mipsel=y
BR2_mips_jz4740=y
BR2_DL_DIR="$(BASE_DIR)/downloads"
BR2_SOURCEFORGE_MIRROR="switch"
BR2_OPTIMIZE_2=y
BR2_KERNEL_HEADERS_VERSION=y
BR2_DEFAULT_KERNEL_VERSION="3.4.1"
BR2_UCLIBC_VERSION_0_9_31=y
BR2_UCLIBC_CONFIG="board/opendingux/a320/uclibc.config"
BR2_BINUTILS_VERSION_2_20_1=y
BR2_GCC_VERSION_4_7_X=y
BR2_PACKAGE_GDB=y
BR2_PACKAGE_GDB_SERVER=y
BR2_PACKAGE_GDB_HOST=y
BR2_TOOLCHAIN_BUILDROOT_LARGEFILE=y
BR2_TOOLCHAIN_BUILDROOT_WCHAR=y
BR2_TOOLCHAIN_BUILDROOT_CXX=y
BR2_TARGET_GENERIC_HOSTNAME="opendingux"
BR2_TARGET_GENERIC_ISSUE="Welcome to OpenDingux"
BR2_ROOTFS_STATIC_DEVICE_TABLE="board/opendingux/mini_device_table.txt"
BR2_ROOTFS_SKELETON_CUSTOM=y
BR2_ROOTFS_SKELETON_CUSTOM_PATH="board/opendingux/a320/target_skeleton"
BR2_BUSYBOX_VERSION_1_19_X=y
BR2_PACKAGE_BUSYBOX_CONFIG="board/opendingux/a320/busybox-1.19.x.config"
BR2_PACKAGE_ALSA_UTILS=y
BR2_PACKAGE_ALSA_UTILS_AMIXER=y
BR2_PACKAGE_ALSA_UTILS_APLAY=y
BR2_PACKAGE_ALSA_UTILS_SPEAKER_TEST=y
BR2_PACKAGE_ALSA_VOLUME=y
BR2_PACKAGE_FLAC=y
BR2_PACKAGE_MADPLAY=y
BR2_PACKAGE_MPG123=y
BR2_PACKAGE_DSTAT=y
BR2_PACKAGE_DMALLOC=y
BR2_PACKAGE_MEMSTAT=y
BR2_PACKAGE_STRACE=y
BR2_PACKAGE_STRESS=y
BR2_PACKAGE_SSTRIP=y
BR2_PACKAGE_FBGRAB=y
BR2_PACKAGE_LIBMIKMOD=y
BR2_PACKAGE_SDL_IMAGE_GIF=y
BR2_PACKAGE_SDL_IMAGE_TARGA=y
BR2_PACKAGE_SDL_SOUND=y
BR2_PACKAGE_SDL_NET=y
BR2_PACKAGE_SDL_GFX=y
BR2_PACKAGE_TIMIDITY_INSTRUMENTS=y
BR2_PACKAGE_DINGOO_TVOUT=y
BR2_PACKAGE_FMTOOLS=y
BR2_PACKAGE_I2C_TOOLS=y
BR2_PACKAGE_MTD=y
BR2_PACKAGE_PWSWD=y
BR2_PACKAGE_PYTHON_CURSES=y
BR2_PACKAGE_PYTHON_PYEXPAT=y
BR2_PACKAGE_PYTHON_READLINE=y
# BR2_PACKAGE_PYTHON_UNICODEDATA is not set
BR2_PACKAGE_PYTHON_SQLITE=y
BR2_PACKAGE_PYTHON_ZLIB=y
BR2_PACKAGE_PYTHON_PYGAME=y
BR2_PACKAGE_PYTHON_PYGAME_IMAGE=y
BR2_PACKAGE_PYTHON_PYGAME_FONT=y
BR2_PACKAGE_PYTHON_PYGAME_MIXER=y
BR2_PACKAGE_PYTHON_PYGAME_MIXER_MUSIC=y
BR2_PACKAGE_ALSA_LIB_DEVDIR="/dev"
# BR2_PACKAGE_ALSA_LIB_RAWMIDI is not set
# BR2_PACKAGE_ALSA_LIB_SEQ is not set
# BR2_PACKAGE_ALSA_LIB_ALISP is not set
# BR2_PACKAGE_ALSA_LIB_OLD_SYMBOLS is not set
BR2_PACKAGE_LIBAO=y
BR2_PACKAGE_LIBSNDFILE=y
BR2_PACKAGE_SPEEX=y
BR2_PACKAGE_TAGLIB=y
BR2_PACKAGE_TAGLIB_MP4=y
BR2_PACKAGE_TAGLIB_ASF=y
BR2_PACKAGE_TREMOR=y
BR2_PACKAGE_LZO=y
BR2_PACKAGE_LIBGCRYPT=y
BR2_PACKAGE_LIBCONFUSE=y
BR2_PACKAGE_LIBSYSFS=y
BR2_PACKAGE_LIBUNGIF=y
BR2_PACKAGE_LIBAIO=y
BR2_PACKAGE_LIBTHEORA=y
BR2_PACKAGE_NEWT=y
BR2_PACKAGE_POPT=y
BR2_PACKAGE_GMENU2X=y
BR2_PACKAGE_BWM_NG=y
BR2_PACKAGE_IPKG=y
BR2_PACKAGE_DIALOG=y
BR2_PACKAGE_FILE=y
BR2_PACKAGE_LOCKFILE_PROGS=y
BR2_PACKAGE_HTOP=y
BR2_PACKAGE_NANO=y
BR2_TARGET_ROOTFS_SQUASHFS=y
# BR2_TARGET_ROOTFS_TAR is not set
```

## configs/gcw0_defconfig
```kconfig
BR2_mipsel=y
BR2_mips_jz4770=y
BR2_OPTIMIZE_2=y
BR2_VENDOR="gcw0"
BR2_UCLIBC_CONFIG="board/opendingux/gcw0/uclibc.config"
BR2_BINUTILS_VERSION_2_22=y
BR2_BINUTILS_EXTRA_CONFIG_OPTIONS="--enable-lto"
BR2_GCC_VERSION_4_7_X=y
BR2_EXTRA_GCC_CONFIG_OPTIONS="--enable-lto"
BR2_PACKAGE_GDB=y
BR2_PACKAGE_GDB_SERVER=y
BR2_PACKAGE_GDB_HOST=y
# BR2_SOFT_FLOAT is not set
BR2_TOOLCHAIN_BUILDROOT_LARGEFILE=y
BR2_TOOLCHAIN_BUILDROOT_WCHAR=y
BR2_TOOLCHAIN_BUILDROOT_CXX=y
BR2_TARGET_GENERIC_HOSTNAME="opendingux"
BR2_TARGET_GENERIC_ISSUE="Welcome to OpenDingux"
BR2_ROOTFS_STATIC_DEVICE_TABLE="board/opendingux/mini_device_table.txt"
BR2_ROOTFS_SKELETON_CUSTOM=y
BR2_ROOTFS_SKELETON_CUSTOM_PATH="board/opendingux/gcw0/target_skeleton"
BR2_PACKAGE_BUSYBOX_CONFIG="board/opendingux/busybox-1.20.x.config"
BR2_PACKAGE_BUSYBOX_SHOW_OTHERS=y
BR2_PACKAGE_ALSA_UTILS=y
BR2_PACKAGE_ALSA_UTILS_AMIDI=y
BR2_PACKAGE_ALSA_UTILS_AMIXER=y
BR2_PACKAGE_ALSA_UTILS_APLAY=y
BR2_PACKAGE_ALSA_UTILS_ACONNECT=y
BR2_PACKAGE_ALSA_UTILS_APLAYMIDI=y
BR2_PACKAGE_ALSA_UTILS_ARECORDMIDI=y
BR2_PACKAGE_ALSA_UTILS_ASEQDUMP=y
BR2_PACKAGE_ALSA_UTILS_ASEQNET=y
BR2_PACKAGE_ALSA_UTILS_SPEAKER_TEST=y
BR2_PACKAGE_ALSA_VOLUME=y
BR2_PACKAGE_FLAC=y
BR2_PACKAGE_MADPLAY=y
BR2_PACKAGE_MPG123=y
BR2_PACKAGE_DSTAT=y
BR2_PACKAGE_DMALLOC=y
BR2_PACKAGE_MEMSTAT=y
BR2_PACKAGE_OPROFILE=y
BR2_PACKAGE_STRACE=y
BR2_PACKAGE_STRESS=y
BR2_PACKAGE_SSTRIP=y
BR2_PACKAGE_FBGRAB=y
BR2_PACKAGE_LIBMIKMOD=y
BR2_PACKAGE_SDL_IMAGE_GIF=y
BR2_PACKAGE_SDL_IMAGE_TARGA=y
BR2_PACKAGE_SDL_IMAGE_XPM=y
BR2_PACKAGE_SDL_SOUND=y
BR2_PACKAGE_SDL_NET=y
BR2_PACKAGE_TIMIDITY_INSTRUMENTS=y
BR2_PACKAGE_E2FSPROGS=y
# BR2_PACKAGE_E2FSPROGS_BADBLOCKS is not set
# BR2_PACKAGE_E2FSPROGS_CHATTR is not set
# BR2_PACKAGE_E2FSPROGS_DUMPE2FS is not set
# BR2_PACKAGE_E2FSPROGS_E2FREEFRAG is not set
# BR2_PACKAGE_E2FSPROGS_E2UNDO is not set
# BR2_PACKAGE_E2FSPROGS_FILEFRAG is not set
# BR2_PACKAGE_E2FSPROGS_FINDFS is not set
# BR2_PACKAGE_E2FSPROGS_FSCK is not set
# BR2_PACKAGE_E2FSPROGS_LOGSAVE is not set
# BR2_PACKAGE_E2FSPROGS_LSATTR is not set
# BR2_PACKAGE_E2FSPROGS_MKLOSTFOUND is not set
BR2_PACKAGE_E2FSPROGS_RESIZE2FS=y
# BR2_PACKAGE_E2FSPROGS_UUIDGEN is not set
BR2_PACKAGE_FMTOOLS=y
BR2_PACKAGE_I2C_TOOLS=y
BR2_PACKAGE_LINUX_FIRMWARE=y
BR2_PACKAGE_LINUX_FIRMWARE_RTL_8192=y
BR2_PACKAGE_PWSWD=y
BR2_PACKAGE_PWSWD_MIXER="PCM"
BR2_PACKAGE_PYTHON_CURSES=y
BR2_PACKAGE_PYTHON_PYEXPAT=y
BR2_PACKAGE_PYTHON_READLINE=y
# BR2_PACKAGE_PYTHON_UNICODEDATA is not set
BR2_PACKAGE_PYTHON_SQLITE=y
BR2_PACKAGE_PYTHON_ZLIB=y
BR2_PACKAGE_PYTHON_PYGAME=y
BR2_PACKAGE_PYTHON_PYGAME_IMAGE=y
BR2_PACKAGE_PYTHON_PYGAME_FONT=y
BR2_PACKAGE_PYTHON_PYGAME_MIXER=y
BR2_PACKAGE_PYTHON_PYGAME_MIXER_MUSIC=y
BR2_PACKAGE_ALSA_LIB_DEVDIR="/dev"
# BR2_PACKAGE_ALSA_LIB_ALISP is not set
# BR2_PACKAGE_ALSA_LIB_OLD_SYMBOLS is not set
BR2_PACKAGE_LIBAO=y
BR2_PACKAGE_LIBSNDFILE=y
BR2_PACKAGE_SPEEX=y
BR2_PACKAGE_TAGLIB=y
BR2_PACKAGE_TAGLIB_MP4=y
BR2_PACKAGE_TAGLIB_ASF=y
BR2_PACKAGE_TREMOR=y
BR2_PACKAGE_LIBGCRYPT=y
BR2_PACKAGE_LIBCONFUSE=y
BR2_PACKAGE_LIBOPK=y
BR2_PACKAGE_LIBSYSFS=y
BR2_PACKAGE_LIBUNGIF=y
BR2_PACKAGE_LIBAIO=y
BR2_PACKAGE_TSLIB=y
BR2_PACKAGE_LIBTHEORA=y
BR2_PACKAGE_LIBXDGMIME=y
BR2_PACKAGE_NEWT=y
BR2_PACKAGE_GMENU2X=y
BR2_PACKAGE_GMENU2X_PLATFORM="gcw0"
BR2_PACKAGE_PYCLOCK=y
BR2_PACKAGE_AVAHI=y
BR2_PACKAGE_AVAHI_DAEMON=y
BR2_PACKAGE_DHCPDUMP=y
BR2_PACKAGE_DROPBEAR=y
BR2_PACKAGE_DROPBEAR_DISABLE_REVERSEDNS=y
# BR2_PACKAGE_DROPBEAR_SMALL is not set
BR2_PACKAGE_HOSTAPD=y
BR2_PACKAGE_HOSTAPD_WPS=y
BR2_PACKAGE_IW=y
BR2_PACKAGE_KISMET=y
BR2_PACKAGE_KISMET_CLIENT=y
BR2_PACKAGE_KISMET_DRONE=y
BR2_PACKAGE_LINKS=y
BR2_PACKAGE_NETCAT=y
BR2_PACKAGE_NTP=y
BR2_PACKAGE_NTP_NTPDATE=y
BR2_PACKAGE_NTP_NTPDC=y
BR2_PACKAGE_NTP_NTPQ=y
BR2_PACKAGE_NTP_TICKADJ=y
BR2_PACKAGE_OPENSSH=y
# BR2_PACKAGE_OPENSSH_START_DAEMON is not set
BR2_PACKAGE_TCPDUMP=y
BR2_PACKAGE_USHARE=y
BR2_PACKAGE_WIRELESS_TOOLS=y
BR2_PACKAGE_WIRELESS_TOOLS_LIB=y
BR2_PACKAGE_WPA_SUPPLICANT=y
BR2_PACKAGE_WPA_SUPPLICANT_CLI=y
BR2_PACKAGE_WPA_SUPPLICANT_PASSPHRASE=y
BR2_PACKAGE_WPA_SUPPLICANT_AP_SUPPORT=y
BR2_PACKAGE_WPA_SUPPLICANT_WPS=y
BR2_PACKAGE_DIALOG=y
BR2_PACKAGE_FILE=y
BR2_PACKAGE_LOCKFILE_PROGS=y
BR2_PACKAGE_BWM_NG=y
BR2_PACKAGE_DINGUX_COMMANDER=y
BR2_PACKAGE_HTOP=y
BR2_PACKAGE_UTIL_LINUX_PARTX=y
BR2_PACKAGE_NANO=y
BR2_TARGET_ROOTFS_SQUASHFS=y
# BR2_TARGET_ROOTFS_TAR is not set
```

## package/alsa-volume/Config.in
```kconfig
config BR2_PACKAGE_ALSA_VOLUME
	bool "alsa-volume"
	select BR2_PACKAGE_ALSA_LIB
	help
	  This package contains a tool to retrieve the volume of
	  a given control of the ALSA mixer.
```

## package/apitrace/Config.in
```kconfig
config BR2_PACKAGE_APITRACE
	bool "apitrace"
	select BR2_PACKAGE_POPT
	select BR2_PACKAGE_BINUTILS
	depends on BR2_INSTALL_LIBSTDCPP
	depends on !BR2_aarch64 # binutils
	help
          apitrace consists of a set of tools to:
          * trace OpenGL, OpenGL ES, Direct3D, and DirectDraw APIs calls to a file;
          * replay OpenGL and OpenGL ES calls from a file;
          * inspect OpenGL state at any call while retracing;
          * visualize and edit trace files.

comment "apitrace requires a toolchain with C++ support enabled"
	depends on !BR2_INSTALL_LIBSTDCPP
```

## package/buteo-mtp/Config.in
```kconfig
config BR2_PACKAGE_BUTEO_MTP
	bool "buteo-mtp"
	depends on BR2_PACKAGE_QT_XML
	help
	  Media Transfer Protocol (MTP) stack from Meego

	  https://github.com/pcercuei/buteo-mtp

comment "buteo-mtp depends on QT xml module"
	depends on !BR2_PACKAGE_QT_XML
```

## package/clang/Config.in.host
```kconfig
config BR2_PACKAGE_HOST_CLANG
	bool "host clang"
	depends on BR2_arm || BR2_armeb || BR2_aarch64 || \
		BR2_i386 || BR2_x86_64 || \
		BR2_mips || BR2_mipsel || \
		BR2_mips64 || BR2_mips64el || \
		BR2_powerpc || BR2_powerpc64 || BR2_powerpc64le || \
		BR2_sparc
	select BR2_PACKAGE_HOST_LLVM
	help
	  Clang is a C language family frontend for LLVM.

	  http://clang.llvm.org
```

## package/confmenu/Config.in
```kconfig
config BR2_PACKAGE_CONFMENU
	bool "confmenu"
	select BR2_PACKAGE_LIBCMENU
	select BR2_PACKAGE_LIBXML2
	select BR2_PACKAGE_SDL
	select BR2_PACKAGE_SDL_IMAGE
	help
	  XML-driven configuration menu based on libcmenu.

	  https://github.com/pcercuei/confmenu
```

## package/dejavu-fonts/Config.in
```kconfig
config BR2_PACKAGE_DEJAVU_FONTS
 bool "dejavu fonts"
 select BR2_PACKAGE_DEJAVU_FONTS_SANS if !BR2_PACKAGE_DEJAVU_FONTS_SERIF
 help
  The DejaVu fonts are a font family based on the Vera Fonts.

  http://dejavu-fonts.org/wiki/Main_Page

if BR2_PACKAGE_DEJAVU_FONTS

config BR2_PACKAGE_DEJAVU_FONTS_SANS
	bool "Install Sans fonts"

config BR2_PACKAGE_DEJAVU_FONTS_SERIF
	bool "Install Serif fonts"

endif
```

## package/dingoo-tvout/Config.in
```kconfig
config BR2_PACKAGE_DINGOO_TVOUT
	bool "dingoo-tvout"
	help
	  TV-out switch tool for Dingoo A320/A330.

	  https://github.com/mthuurne/dingoo-tvout
```

## package/dingux-commander/Config.in
```kconfig
config BR2_PACKAGE_DINGUX_COMMANDER
	bool "DinguxCommander"
	help
	  Two-pane file manager in the style of Norton Commander.

	  http://beyondds.free.fr/index.php?Dingoo-dinguxcommander
```

## package/fusezip/Config.in
```kconfig
config BR2_PACKAGE_FUSEZIP
	bool "fusezip"
	select BR2_PACKAGE_LIBZIP
	select BR2_PACKAGE_LIBFUSE
	help
	  fuse-zip is a FUSE file system to navigate, extract,
	  create and modify ZIP archives.

	  http://code.google.com/p/fuse-zip/
```

## package/gmenu2x/Config.in
```kconfig
config BR2_PACKAGE_GMENU2X
	bool "gmenu2x"
	select BR2_PACKAGE_LIBPNG
	select BR2_PACKAGE_SDL
	select BR2_PACKAGE_SDL_GFX
	help
	  Application menu for devices with a 320x240 screen and buttons.

	  This is a forked version with cleanups, targeted at the Ben NanoNote
	  and the Dingoo A320/A330.

	  http://projects.qi-hardware.com/index.php/p/gmenu2x
```

## package/ingenic-boot/Config.in
```kconfig
config BR2_PACKAGE_INGENIC_BOOT
	bool "ingenic-boot"
	select BR2_PACKAGE_LIBUSB
	select BR2_PACKAGE_LIBUSB_COMPAT
	select BR2_PACKAGE_LIBCONFUSE
	help
	  Ingenic-boot is a linux port of Ingenic usb boot tools.

	  http://github.com/gcwnow/ingenic-boot
```

## package/libcmenu/Config.in
```kconfig
config BR2_PACKAGE_LIBCMENU
	bool "libcmenu"
	select BR2_PACKAGE_LIBINI
	select BR2_PACKAGE_SDL
	select BR2_PACKAGE_SDL_TTF
	select BR2_PACKAGE_DEJAVU_FONTS
	help
	  Library to easily create configuration menus from C

	  https://github.com/pcercuei/libcmenu
```

## package/libglog/Config.in
```kconfig
config BR2_PACKAGE_LIBGLOG
	bool "libglog"
	depends on BR2_INSTALL_LIBSTDCPP
	help
	  Logging library for C++

	  http://code.google.com/p/google-glog/

comment "libglog needs a toolchain w/ C++"
	depends on !BR2_INSTALL_LIBSTDCPP
```

## package/libmikmod/Config.in
```kconfig
config BR2_PACKAGE_LIBMIKMOD
	bool "libmikmod"
	help
	  Mikmod is a module player and library supporting many
	  formats, including mod, s3m, it, and xm.

	  http://mikmod.raphnet.net
```

## package/libmodplug/Config.in
```kconfig
config BR2_PACKAGE_LIBMODPLUG
	bool "libmodplug"
	help
	  Library to play lots of tracker formats (including MOD, S3M, XM) and
	  also standard MIDI files.

	  http://modplug-xmms.sourceforge.net/
```

## package/libmtpserver/Config.in
```kconfig
config BR2_PACKAGE_LIBMTPSERVER
	bool "libmtpserver"
	# Dependencies are inherited from Boost
	depends on BR2_USE_MMU
	depends on BR2_INSTALL_LIBSTDCPP
	depends on BR2_LARGEFILE
	depends on BR2_TOOLCHAIN_HAS_THREADS
	select BR2_PACKAGE_BOOST
	select BR2_PACKAGE_BOOST_FILESYSTEM
	select BR2_PACKAGE_BOOST_SYSTEM
	select BR2_PACKAGE_BOOST_TEST
	select BR2_PACKAGE_BOOST_THREAD
	select BR2_PACKAGE_LIBGLOG
	help
	  MTP server

comment "libmtpserver needs a toolchain w/ C++, MMU, largefile, threads"
	depends on !BR2_INSTALL_LIBSTDCPP || !BR2_LARGEFILE || !BR2_TOOLCHAIN_HAS_THREADS || !BR2_USE_MMU
```

## package/libopk/Config.in
```kconfig
config BR2_PACKAGE_LIBOPK
	bool "libopk"
	select BR2_PACKAGE_ZLIB
	help
	  Library to handle the OPK packages.

	  https://github.com/pcercuei/libopk
```

## package/libshake/Config.in
```kconfig
config BR2_PACKAGE_LIBSHAKE
	bool "libshake"
	help
	  A basic haptic library using the Linux Force Feedback API.

	  https://github.com/zear/libShake
```

## package/libuv/Config.in
```kconfig
config BR2_PACKAGE_LIBUV
	bool "libuv"
	help
	  Cross-platform asychronous I/O library

	  http://libuv.org
```

## package/libv8/Config.in
```kconfig
config BR2_PACKAGE_LIBV8
	bool "libv8"
	depends on BR2_mipsel || BR2_x86_64 || BR2_i386 || BR2_arm
	help
	  Google V8 Javascript engine

	  https://code.google.com/p/v8/

if BR2_PACKAGE_LIBV8
comment "WARNING: a multilib-enabled host compiler might be required!"

config BR2_PACKAGE_LIBV8_INSTALL_RUNTIME
	bool "Install d8 runtime"
	default y
	help
	  Install the 'd8' runtime executable

endif
```

## package/llvm/Config.in.host
```kconfig
config BR2_PACKAGE_HOST_LLVM
	bool "host llvm"
	depends on BR2_arm || BR2_armeb || BR2_aarch64 || \
		BR2_i386 || BR2_x86_64 || \
		BR2_mips || BR2_mipsel || \
		BR2_mips64 || BR2_mips64el || \
		BR2_powerpc || BR2_powerpc64 || BR2_powerpc64le || \
		BR2_sparc
	help
	  The LLVM Project is a collection of modular and reusable compiler
	  and toolchain technologies.

	  http://llvm.org
```

## package/openssh/Config.in
```kconfig
config BR2_PACKAGE_OPENSSH
	bool "openssh"
	select BR2_PACKAGE_OPENSSL
	select BR2_PACKAGE_ZLIB
	help
	  A free version of the SSH protocol suite of network connectivity
	  tools.  The standard 'ssh', 'sshd', 'scp', and friends.

	  http://www.openssh.com/

if BR2_PACKAGE_OPENSSH

config BR2_PACKAGE_OPENSSH_START_DAEMON
	bool "Start OpenSSH daemon at boot"
	default y
	help
	  If you disable this option, the init script will not be installed
	  and as a result the OpenSSH daemon will not be started at boot.
	  Also the host key generation on first boot is skipped.

	  This is useful if you only want OpenSSH for the client programs
	  or if you use Dropbear as the SSH server but want to add SFTP
	  support.

endif # BR2_PACKAGE_OPENSSH
```

## package/pwswd/Config.in
```kconfig
config BR2_PACKAGE_PWSWD
	bool "pwswd"
	help
	  Power Switch Daemon for Dingoo A320/A330 and GCW Zero.
	  It allows the user to change various system settings such as brightness,
	  volume, TV-out and more by pressing the power slider plus a button.

	  https://github.com/pcercuei/pwswd

if BR2_PACKAGE_PWSWD

config BR2_PACKAGE_PWSWD_PLATFORM
	string "Target platform"

config BR2_PACKAGE_PWSWD_MIXER
	string "Volume mixer"

endif
```
