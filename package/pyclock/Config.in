## package/pyclock/Config.in
```kconfig
config BR2_PACKAGE_PYCLOCK
	bool "pyCLOCK"
	help
	  Clock application that includes an analog clock, a calendar, a wakeup
	  alarm and a countdown timer. It can also be used to adjust the current
	  system time.

	  https://github.com/BouKiCHi/pyCLOCK
```

## package/vsftpd/Config.in
```kconfig
config BR2_PACKAGE_VSFTPD
	bool "vsftpd"
	help
	  vsftpd is an ftp daemon written with security in mind.
	  http://vsftpd.beasts.org/

if BR2_PACKAGE_VSFTPD

config BR2_PACKAGE_VSFTPD_START_DAEMON
	bool "Start vsftpd at boot"
	default y
	help
	  If you disable this option, the init script will not be installed
	  and as a result vsftpd will not be started at boot.

	  This is useful if you only want to run vsftpd from xinetd.

endif # BR2_PACKAGE_VSFTPD
```

## toolchain/toolchain-buildroot/Config.in
```kconfig
# Config entries for internal toolchain backend

if BR2_TOOLCHAIN_BUILDROOT

config BR2_VENDOR
	string "Toolchain vendor in GNU configuration name"
	default "buildroot"
	help
	  The GNU build system identifies a machine using configuration name
	  in the following format:
	    <arch>-<vendor>-<kernel>-<os>
	  This option lets you select the vendor part of that string.

	  Usually it is best to stick with the default value of "buildroot".

source "toolchain/kernel-headers/Config.in"
source "toolchain/uClibc/Config.in"
source "package/binutils/Config.in.host"
source "toolchain/gcc/Config.in"
endif
```
